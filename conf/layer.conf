## conf/layer.conf
```bitbake
# We have a conf and classes directory, add to BBPATH
BBPATH .= ":${LAYERDIR}"

# We have recipes-* directories, add to BBFILES
BBFILES += "${LAYERDIR}/recipes-*/*/*.bb \
            ${LAYERDIR}/recipes-*/*/*.bbappend"

BBFILE_COLLECTIONS += "meta-kismet"
BBFILE_PATTERN_meta-kismet = "^${LAYERDIR}/"
BBFILE_PRIORITY_meta-kismet = "6"

LAYERDEPENDS_meta-kismet = "core"
LAYERSERIES_COMPAT_meta-kismet = "dunfell"
```
